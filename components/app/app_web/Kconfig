## components/app/app_web/Kconfig
```kconfig
menu "APP WEB"

    config APP_WEB_PORT
        int "HTTP server port"
        range 1 65535
        default 80

    config APP_WEB_TASK_STACK
        int "HTTP server task stack (bytes)"
        range 2048 16384
        default 5120
        help
            Needs headroom for JSON parsing once the API handlers are wired to
            app_synth.

    config APP_WEB_MAX_SOCKETS
        int "Max concurrent connections"
        range 1 7
        default 4
        help
            Kept below CONFIG_LWIP_MAX_SOCKETS so other sockets (MIDI over
            network, OTA, ...) still have room.

endmenu
```

## components/bsp/bsp_adc/Kconfig
```kconfig
menu "BSP ADC"

    config BSP_ADC_VBAT_GPIO
        int "ADC input GPIO (battery voltage sense)"
        default 10

    config BSP_ADC_ATTEN
        int "ADC attenuation (0=0dB, 1=2.5dB, 2=6dB, 3=12dB)"
        default 3
        range 0 3
        help
            12dB gives the widest input range (~0-3.3V), which matches a
            resistor-divided battery sense input.
endmenu
```

## components/bsp/bsp_i2c/Kconfig
```kconfig
menu "BSP (Cardputer)"

    menu "I2C"
        config BSP_I2C_PORT
            int "I2C port number"
            default 0

        config BSP_I2C_SDA_GPIO
            int "I2C SDA GPIO"
            default 8

        config BSP_I2C_SCL_GPIO
            int "I2C SCL GPIO"
            default 9
    endmenu

endmenu
```

## components/bsp/bsp_i2s/Kconfig
```kconfig
menu "BSP I2S"

    config BSP_I2S_SCK_GPIO
        int "I2S SCK (BCLK) GPIO"
        default 41

    config BSP_I2S_LRCK_GPIO
        int "I2S LRCK (WS) GPIO"
        default 43

    config BSP_I2S_DSDIN_GPIO
        int "I2S DSDIN GPIO (speaker DAC data in, ESP TX)"
        default 42

    config BSP_I2S_ASDOUT_GPIO
        int "I2S ASDOUT GPIO (mic ADC data out, ESP RX)"
        default 46
        help
            Cardputer's mic and speaker share one I2S bus (BCLK/WS) with separate
            data lines: DSDIN carries ESP->speaker audio, ASDOUT carries
            mic->ESP audio. MCLK is unused.
endmenu
```

## components/bsp/bsp_spi/Kconfig
```kconfig
menu "BSP SPI"

    config BSP_SPI_HOST
        int "SPI host (1=SPI2_HOST, 2=SPI3_HOST)"
        default 1
        range 1 2

    config BSP_SPI_MOSI_GPIO
        int "SPI MOSI GPIO"
        default 35

    config BSP_SPI_SCLK_GPIO
        int "SPI SCLK GPIO"
        default 36

    config BSP_SPI_CS_GPIO
        int "Default SPI CS GPIO"
        default 37
        help
            Cardputer only wires one CS line today. MISO is unused (not wired).
            Device drivers should use this pin for spics_io_num unless they
            have their own dedicated CS line.
endmenu
```

## components/drv/drv_bmi270/Kconfig
```kconfig
menu "DRV BMI270"

    config DRV_BMI270_I2C_ADDR
        hex "BMI270 I2C address"
        default 0x68
        help
            Cardputer-ADV wires the BMI270 at 0x68 (SDO pin low) on the
            shared I2C bus (SDA=G8, SCL=G9).
endmenu
```

## components/drv/drv_es8311/Kconfig
```kconfig
menu "DRV ES8311"

    config DRV_ES8311_I2C_ADDR
        hex "ES8311 I2C address"
        default 0x18
        help
            0x18 when the codec's CE pin is tied low (Cardputer-ADV default),
            0x19 if tied high.

    config DRV_ES8311_I2C_SPEED_HZ
        int "ES8311 I2C clock speed (Hz)"
        default 100000
endmenu
```

## components/drv/drv_st7789/Kconfig
```kconfig
menu "DRV ST7789"

    config DRV_ST7789_RST_GPIO
        int "ST7789 RST GPIO"
        default 33

    config DRV_ST7789_DC_GPIO
        int "ST7789 DC/RS GPIO"
        default 34

    config DRV_ST7789_BL_GPIO
        int "ST7789 backlight GPIO"
        default 38

endmenu
```

## components/drv/drv_tca8418/Kconfig
```kconfig
menu "DRV TCA8418"

    config DRV_TCA8418_I2C_ADDR
        hex "TCA8418 I2C address"
        default 0x34

    config DRV_TCA8418_I2C_SPEED_HZ
        int "TCA8418 I2C clock speed (Hz)"
        default 400000

    config DRV_TCA8418_INT_GPIO
        int "TCA8418 INT GPIO"
        default 11

    config DRV_TCA8418_ROWS
        int "Keypad matrix rows"
        default 7

    config DRV_TCA8418_COLS
        int "Keypad matrix columns"
        default 8
        help
            Cardputer-ADV wires the TCA8418 as a 7x8 keypad matrix
            (SDA=G8, SCL=G9, INT=G11), per M5Stack's official pin map.
endmenu
```

## components/sys/sys_audio/Kconfig
```kconfig
menu "SYS AUDIO"

    config SYS_AUDIO_SAMPLE_RATE_HZ
        int "Audio output sample rate (Hz)"
        default 44100
        help
            Must be a rate drv_es8311 supports at 16-bit/BCLK-derived clocking:
            32000, 44100, 48000, 64000, 88200 or 96000 Hz.

    config SYS_AUDIO_DEFAULT_VOLUME_PCT
        int "Default speaker volume (%)"
        range 0 100
        default 70

    config SYS_AUDIO_FRAME_SAMPLES
        int "Transmit frame size (samples)"
        default 256
        help
            Size, in 16-bit mono samples, of the shared transmit frame that
            producers fill via sys_audio_get_frame before calling
            sys_audio_send_frame.
endmenu
```

## components/sys/sys_wlan/Kconfig
```kconfig
menu "SYS WLAN"

    config SYS_WLAN_STA_SSID
        string "Fallback station SSID"
        default ""
        help
            Used by sys_wlan_connect_saved() when NVS holds no credentials yet.
            Leave empty to require provisioning (web page / sys_wlan_connect()).

    config SYS_WLAN_STA_PASSWORD
        string "Fallback station password"
        default ""
        help
            Password for SYS_WLAN_STA_SSID. Empty means an open network.

    config SYS_WLAN_MAX_RETRY
        int "Station reconnect attempts"
        range 0 100
        default 5
        help
            How many times to retry before reporting the connection as failed.
            0 retries forever.

    config SYS_WLAN_RECONNECT_DELAY_MS
        int "Delay between reconnect attempts (ms)"
        range 100 60000
        default 2000

    config SYS_WLAN_HOSTNAME
        string "Hostname / DHCP client name"
        default "cardputer"

    config SYS_WLAN_AP_SSID
        string "SoftAP SSID prefix"
        default "Cardputer"
        help
            sys_wlan_ap_start(NULL, ...) appends the last two MAC bytes, e.g.
            "Cardputer-3A7C", so several boards can coexist.

    config SYS_WLAN_AP_PASSWORD
        string "SoftAP password"
        default ""
        help
            Used by sys_wlan_auto_connect()'s fallback AP. Empty means an open
            AP; otherwise at least 8 characters (WPA2 minimum).

    config SYS_WLAN_AP_CHANNEL
        int "SoftAP channel"
        range 1 13
        default 1

    config SYS_WLAN_AP_MAX_CONN
        int "SoftAP max simultaneous clients"
        range 1 10
        default 4

    config SYS_WLAN_AP_AUTO_STOP_MS
        int "Auto-stop SoftAP delay after station connects (ms)"
        range 0 60000
        default 5000
        help
            When the station obtains an IP while the SoftAP is running, the
            SoftAP is stopped after this delay. The grace period lets a
            provisioning page show the result before the client's hotspot
            link drops. 0 keeps the AP running.

    config SYS_WLAN_MAX_EVENT_CBS
        int "Max registered event callbacks"
        range 1 8
        default 4
        help
            Size of the fixed callback table used by
            sys_wlan_register_event_cb() (UI, web server, ...).

endmenu
```
